/* Userspace linker script (generated from link.ld.in by build.rs).
 *
 * Base VA @USER_CODE_BASE_HEX@ (4 MB). All sections @PAGE_SIZE@-byte aligned
 * so the kernel's ELF loader can map whole pages with correct permissions.
 * Values substituted from system_config.rs — do not hardcode here.
 */
ENTRY(_start)
SECTIONS {
    . = @USER_CODE_BASE_HEX@;
    .text   : ALIGN(@PAGE_SIZE@) { *(.text .text.*) }
    .rodata : ALIGN(@PAGE_SIZE@) { *(.rodata .rodata.*) }
    .data   : ALIGN(@PAGE_SIZE@) { *(.data .data.*) }
    .bss    : ALIGN(@PAGE_SIZE@) { *(.bss .bss.* COMMON) }
}
